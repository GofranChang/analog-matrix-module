## drivers/kscan/Kconfig
```kconfig
if KSCAN

config ZMK_ANALOG_MATRIX
    bool

if ZMK_ANALOG_MATRIX

config ZMK_ANALOG_MATRIX_CALIBRATOR
	bool "Build in the calibrator needed for initial setup of the matrix"

if ZMK_ANALOG_MATRIX_CALIBRATOR

config ZMK_ANALOG_MATRIX_VERBOSE_CALIBRATOR
	bool "Verbose Calibration"

endif # ZMK_ANALOG_MATRIX_CALIBRATOR

config ZMK_ANALOG_MATRIX_SETTINGS
	bool "Analog Matrix Settings Storage"
	default y
	depends on SETTINGS

config ZMK_ANALOG_MATRIX_SETTINGS_DISCRETE
	bool "Store individual calibration entries as disrete settings"
	depends on ZMK_ANALOG_MATRIX_SETTINGS
	help
	  Store each key position calibration data as separate settings values.
	  This is mostly useful on platforms like SAM0 (e.g. SAMD21) which have
	  limits on the size a given setting value can be.

config ZMK_ANALOG_MATRIX_SETTINGS_NAME_PREFIX
	string
	help
	  The string prefix used in the final settings named for calibration data.
	  Set by drivers to a meaningful value, e.g. "ec"

config ZMK_ANALOG_MATRIX_DYNAMIC_POLL_RATE
	bool "Dynamic poll rate for power savings"

config ZMK_ANALOG_MATRIX_SHELL
	bool
	depends on SHELL

endif # ZMK_ANALOG_MATRIX

config ZMK_ANALOG_MATRIX_SCAN_RATE_CALC
	bool "Analog matrix scan rate calculation"
	depends on ZMK_ANALOG_MATRIX
	select TIMING_FUNCTIONS
	help
	  Calculate and store information about the timing for a given scan of the matrix,
	  which can be accessed using the shell, e.g. `ec matrix scan_rate`.

rsource "Kconfig.ec"
rsource "Kconfig.he"

endif
```

## drivers/kscan/Kconfig.he
```kconfig
config ZMK_KSCAN_HE_MATRIX
    bool "HE Matrix KScan Driver"
    default y
    depends on DT_HAS_ZMK_KSCAN_HE_MATRIX_ENABLED
    select ZMK_ANALOG_MATRIX

if ZMK_KSCAN_HE_MATRIX

config ZMK_ANALOG_MATRIX_SETTINGS_NAME_PREFIX
	default "he"

config ZMK_KSCAN_HE_MATRIX_SHELL
	bool "HE Matrix Shell"
	default y
	select ZMK_ANALOG_MATRIX_SHELL
	depends on SHELL

config ZMK_KSCAN_HE_MATRIX_THREAD_PRIORITY
	int "Thread priority"
	default 1
	help
	  Priority of thread used by the driver to handle interrupts.

config ZMK_KSCAN_HE_MATRIX_THREAD_STACK_SIZE
	int "Thread stack size"
	default 768
	help
	  Stack size of thread used by the driver to handle interrupts.

endif # ZMK_KSCAN_HE_MATRIX
```

## dts/bindings/kscan/zmk,kscan-analog-matrix.yaml
```yaml
# Copyright (c) 2020, The ZMK Contributors
# SPDX-License-Identifier: MIT

description: Base analog matrix device

include: [kscan.yaml]

properties:
  trigger-percentage:
    type: int
    default: 50
    description: Pressed threshold as a percentage of the full range, where 0% is not pressed at all and 100% is pressed fully.
  active-polling-interval-ms:
    type: int
    default: 1
  idle-polling-interval-ms:
    type: int
    default: 50
  sleep-polling-interval-ms:
    type: int
    default: 200
  dynamic-polling-interval:
    type: boolean
  idle-after-secs:
    type: int
    default: 5
  sleep-after-secs:
    type: int
    default: 300
  precalib-avg-lows:
    type: array
    description: Pre-seeded avg low calibration values
  precalib-avg-highs:
    type: array
    description: Pre-seeded avg high calibration values
```

## dts/bindings/kscan/zmk,kscan-ec-matrix.yaml
```yaml
# Copyright (c) 2020, The ZMK Contributors
# SPDX-License-Identifier: MIT

description: GPIO keyboard demux controller

compatible: "zmk,kscan-ec-matrix"

include: ["zmk,kscan-analog-matrix.yaml", pinctrl-device.yaml]

properties:
  skip-startup-calibration:
    type: boolean
  matrix-warm-up-us:
    type: int
  matrix-relax-us:
    type: int
  adc-read-settle-us:
    type: int
  power-gpios:
    type: phandle-array
  power-off-gpios:
    type: phandle-array
    description: |
      Control GPIOs connected to the power-gated matrix circuitry. Drive these
      physically low before turning power-gpios off to avoid input-clamp
      back-powering. Only use pins for which physical low is safe while the
      matrix is powered down. The configured active polarity is ignored when
      parking these pins; use the same active polarity as the pin's existing
      controller so GPIO configuration does not change its logical behavior.
      Normal scan-time control remains with the mux driver.
  input-gpios:
    type: phandle-array
    required: true
  strobe-gpios:
    type: phandle-array
    required: true
  strobe-input-masks:
    type: array
    description: Array of masked inputs for each strobe line. Those set bits are indexes of inputs to skip for each strobe line.
  drain-gpios:
    type: phandle-array
  io-channels:
    required: true
  
  pinctrl-0:
    required: false
  pinctrl-names:
    required: false
```

## dts/bindings/kscan/zmk,kscan-he-matrix.yaml
```yaml
# Copyright (c) 2020, The ZMK Contributors
# SPDX-License-Identifier: MIT

description: HE analog matrix

compatible: "zmk,kscan-he-matrix"

include: ["zmk,kscan-analog-matrix.yaml"]

properties:
  skip-startup-calibration:
    type: boolean
  select-gpios:
    type: phandle-array
    required: true
  channel-select-masks:
    type: array
    description: Array of masked selects for each io-channels. Those set bits are indexes of selects to skip for each io-channel.
  io-channels:
    required: true
  high-threshold-noise-mult:
    type: int
    default: 4
```

## tests/he/calibrator/testcase.yaml
```yaml
tests:
  matrix.analog.he.calibrator:
    tags:
      - kscan
      - drivers
    integration_platforms:
      - native_sim
```

## tests/he/scanning/testcase.yaml
```yaml
tests:
  matrix.analog.he.scanning:
    tags:
      - kscan
      - drivers
    integration_platforms:
      - native_sim
```

## tests/west.yml
```yaml
manifest:
  group-filter: [-hal, -babblesim]
  remotes:
    - name: zephyrproject-rtos
      url-base: https://github.com/zephyrproject-rtos
  projects:
    - name: zephyr
      remote: zephyrproject-rtos
      revision: v4.1.0
      clone-depth: 1
      import:
        name-blocklist:
          - ci-tools
          - nrf_hw_models
          - loramac-node
          - mcuboot
          - mcumgr
          - net-tools
          - openthread
          - edtt
          - trusted-firmware-m
          - lvgl
          - littlefs
  self:
    path: tests
```
